## west.yml
```yaml
manifest: 
  group-filter: [-infr]
  
  defaults:
      remote: github-xmos

  remotes:
    - name: github-xmos
      url-base: git@github.com:xmos
    - name: github-int
      url-base: git@github0.xmos.com:xmos-int

  self: 
      path: sw_usb_audio

  projects: 
    - name: lib_xua
      revision: v3.3.1

    - name: lib_dsp
      revision: v6.2.1

    - name: lib_i2c
      revision: v6.1.1

    - name: lib_i2s
      revision: v5.0.0

    - name: lib_locks
      revision: v2.1.0
    
    - name: lib_logging
      revision: v3.1.1
    
    - name: lib_mic_array
      revision: v4.5.0
    
    - name: lib_spdif
      revision: v4.2.1
  
    - name: lib_xassert
      revision: v4.1.0

    - name: lib_xud
      revision: v2.2.1

    - name: lib_adat
      revision: v1.0.1

    - name: tools_released
      groups: [infr]
      remote: github-int
      revision: v15.1.4

    - name: xdoc_released
      groups: [infr]
      remote: github-int
      revision: 5f7494dd290e92dbf68038091bb53d2605644616

    - name: infr_scripts_pl
      groups: [infr]
      revision: 227ca03fe0b6c4382579101e8b3672b34f8668b7

    - name: infr_scripts_py
      groups: [infr]
      revision: 1d767cbe89a3223da7a4e27c283fb96ee2a279c9

    - name: infr_apps
      groups: [infr]
      revision: 4471a9ecbdf26ab77829c36327225f1fc386a082

    - name: tools_xmostest
      groups: [infr]
      remote: github-int
      revision: 1e2d0097624e0df9c92981d2fc652fda3f81b9e2
      
    - name: xtagctl
      groups: [infr]
      remote: github-int
      revision: v1.7.0
```
